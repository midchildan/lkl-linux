## arch/lkl/Kconfig
```kconfig
config LKL
       def_bool y
       depends on !SMP && !MMU && !COREDUMP && !SECCOMP && !UPROBES && !COMPAT && !USER_RETURN_NOTIFIER
       select ARCH_THREAD_STACK_ALLOCATOR
       select RWSEM_GENERIC_SPINLOCK
       select GENERIC_ATOMIC64
       select GENERIC_HWEIGHT
       select FLATMEM
       select FLAT_NODE_MEM_MAP
       select GENERIC_CLOCKEVENTS
       select GENERIC_CPU_DEVICES
       select NO_HZ_IDLE
       select NO_PREEMPT
       select ARCH_WANT_FRAME_POINTERS
       select HAS_DMA
       select PHYS_ADDR_T_64BIT if 64BIT
       select 64BIT if OUTPUT_FORMAT = "elf64-x86-64"
       select 64BIT if OUTPUT_FORMAT = "pe-x86-64"
       select HAVE_UNDERSCORE_SYMBOL_PREFIX if OUTPUT_FORMAT = "pe-i386"
       select 64BIT if OUTPUT_FORMAT = "elf64-x86-64-freebsd"
       select IP_PNP
       select IP_PNP_DHCP
       select TCP_CONG_BBR
       select HIGH_RES_TIMERS
       select NET_SCHED
       select NET_SCH_FQ
       select FUTEX
       select 9P_FS
       select NET_9P
       select NET_9P_VIRTIO
       select NET_9P_DEBUG
       select LKL_RASPI2 if OUTPUT_FORMAT = "elf32-littlearm"

config OUTPUTFORMAT
       string
       option env="OUTPUT_FORMAT"

config OUTPUT_FORMAT
       string "Output format"
       default OUTPUTFORMAT

config ARCH_DMA_ADDR_T_64BIT
       def_bool 64BIT

config 64BIT
       def_bool n

config BIG_ENDIAN
       def_bool n

config KALLSYMS_BASE_RELATIVE
       def_bool n

config TTY
       def_bool n

config GENERIC_CSUM
       def_bool y

config GENERIC_HWEIGHT
       def_bool y

config NO_IOPORT_MAP
       def_bool y

config RWSEM_GENERIC_SPINLOCK
	bool
	default y

config PCI
	bool "PCI support"
	select NO_GENERIC_PCI_IOPORT_MAP
	select GENERIC_PCI_IOMAP
	default y

config LKL_RASPI2
       bool  "Raspberry Pi 2 support"
       default n
       imply EMBEDDED
       imply ARCH_ARCH_MULTI_V7
       imply ARCH_VIRT
       imply ARCH_ALPINE
       imply ARCH_ARTPEC
       imply MACH_ARTPEC6
       imply ARCH_MVEBU
       imply MACH_ARMADA_370
       imply MACH_ARMADA_375
       imply MACH_ARMADA_38X
       imply MACH_ARMADA_39X
       imply MACH_ARMADA_XP
       imply MACH_DOVE
       imply ARCH_AT91
       imply SOC_SAMA5D2
       imply SOC_SAMA5D3
       imply SOC_SAMA5D4
       imply ARCH_BCM
       imply ARCH_BCM_CYGNUS
       imply ARCH_BCM_NSP
       imply ARCH_BCM_21664
       imply ARCH_BCM_281XX
       imply ARCH_BCM_5301X
       imply ARCH_BCM2835
       imply ARCH_BCM_63XX
       imply ARCH_BRCMSTB
       imply ARCH_BERLIN
       imply MACH_BERLIN_BG2
       imply MACH_BERLIN_BG2CD
       imply MACH_BERLIN_BG2Q
       imply ARCH_DIGICOLOR
       imply ARCH_HIGHBANK
       imply ARCH_HISI
       imply ARCH_HI3xxx
       imply ARCH_HIX5HD2
       imply ARCH_HIP01
       imply ARCH_HIP04
       imply ARCH_KEYSTONE
       imply ARCH_MESON
       imply ARCH_MXC
       imply SOC_IMX50
       imply SOC_IMX51
       imply SOC_IMX53
       imply SOC_IMX6Q
       imply SOC_IMX6SL
       imply SOC_IMX6SX
       imply SOC_IMX6UL
       imply SOC_IMX7D
       imply SOC_VF610
       imply SOC_LS1021A
       imply ARCH_OMAP3
       imply ARCH_OMAP4
       imply SOC_OMAP5
       imply SOC_AM33XX
       imply SOC_AM43XX
       imply SOC_DRA7XX
       imply ARCH_QCOM
       imply ARCH_MEDIATEK
       imply ARCH_MSM8X60
       imply ARCH_MSM8960
       imply ARCH_MSM8974
       imply ARCH_ROCKCHIP
       imply ARCH_SOCFPGA
       imply PLAT_SPEAR
       imply ARCH_SPEAR13XX
       imply MACH_SPEAR1310
       imply MACH_SPEAR1340
       imply ARCH_STI
       imply ARCH_EXYNOS
       imply EXYNOS5420_MCPM
       imply ARCH_RENESAS
       imply ARCH_EMEV2
       imply ARCH_R7S72100
       imply ARCH_R8A73A4
       imply ARCH_R8A7740
       imply ARCH_R8A7778
       imply ARCH_R8A7779
       imply ARCH_R8A7790
       imply ARCH_R8A7791
       imply ARCH_R8A7792
       imply ARCH_R8A7793
       imply ARCH_R8A7794
       imply ARCH_SH73A0
       imply ARCH_SUNXI
       imply ARCH_SIRF
       imply ARCH_TEGRA
       imply ARCH_TEGRA_2x_SOC
       imply ARCH_TEGRA_3x_SOC
       imply ARCH_TEGRA_114_SOC
       imply ARCH_TEGRA_124_SOC
       imply TEGRA_EMC_SCALING_ENABLE
       imply ARCH_UNIPHIER
       imply ARCH_U8500
       imply MACH_HREFV60
       imply MACH_SNOWBALL
       imply ARCH_VEXPRESS
       imply ARCH_VEXPRESS_CA9X4
       imply ARCH_VEXPRESS_TC2_PM
       imply ARCH_WM8850
       imply ARCH_ZYNQ
       imply TRUSTED_FOUNDATIONS
       imply PCI
       imply PCI_HOST_GENERIC
       imply PCI_KEYSTONE
       imply PCI_MSI
       imply PCI_MVEBU
       imply PCI_TEGRA
       imply PCI_RCAR_GEN2
       imply PCIE_RCAR
       imply PCIEPORTBUS
       imply SMP
       #imply NR_CPUS=16
       imply HIGHPTE
       imply CMA
       imply SECCOMP
       imply ARM_APPENDED_DTB
       imply ARM_ATAG_DTB_COMPAT
       imply KEXEC
       imply EFI
       imply CPU_FREQ
       imply CPU_FREQ_STAT_DETAILS
       imply CPU_FREQ_DEFAULT_GOV_ONDEMAND
       #imply CPU_FREQ_GOV_POWERSAVE
       #imply CPU_FREQ_GOV_USERSPACE
       #imply CPU_FREQ_GOV_CONSERVATIVE
       imply CPU_FREQ_GOV_SCHEDUTIL
       imply ARM_IMX6Q_CPUFREQ
       imply QORIQ_CPUFREQ
       imply CPU_IDLE
       imply ARM_CPUIDLE
       imply NEON
       imply KERNEL_MODE_NEON
       imply ARM_ZYNQ_CPUIDLE
       imply ARM_EXYNOS_CPUIDLE
       imply NET
       imply PACKET
       imply UNIX
       imply INET
       imply IP_PNP
       imply IP_PNP_DHCP
       imply IP_PNP_BOOTP
       imply IP_PNP_RARP
       imply IPV6_ROUTER_PREF
       imply IPV6_OPTIMISTIC_DAD
       #imply INET6_AH
       #imply INET6_ESP
       #imply INET6_IPCOMP
       #imply IPV6_MIP6
       #imply IPV6_TUNNEL
       imply IPV6_MULTIPLE_TABLES
       #imply NET_DSA
       imply NET_SWITCHDEV
       imply CAN
       imply CAN_RAW
       imply CAN_BCM
       imply CAN_DEV
       #imply CAN_AT91
       #imply CAN_RCAR
       imply CAN_XILINXCAN
       imply CAN_MCP251X
       #imply NET_DSA_BCM_SF2
       #imply B53
       #imply B53_SPI_DRIVER
       #imply B53_MDIO_DRIVER
       #imply B53_MMAP_DRIVER
       #imply B53_SRAB_DRIVER
       imply CAN_SUN4I
       #imply BT
       #imply BT_MRVL
       #imply BT_MRVL_SDIO
       #imply CFG80211
       #imply MAC80211
       imply RFKILL
       imply RFKILL_INPUT
       imply RFKILL_GPIO
       imply DEVTMPFS
       imply DEVTMPFS_MOUNT
       imply DMA_CMA
       #imply CMA_SIZE_MBYTES=64
       imply OMAP_OCP2SCP
       imply SIMPLE_PM_BUS
       ##imply SUNXI_RSB
       imply MTD
       imply MTD_CMDLINE_PARTS
       imply MTD_BLOCK
       imply MTD_M25P80
       imply MTD_NAND
       imply MTD_NAND_DENALI_DT
       imply MTD_NAND_ATMEL
       imply MTD_NAND_BRCMNAND
       imply MTD_NAND_VF610_NFC
       imply MTD_NAND_DAVINCI
       imply MTD_SPI_NOR
       #imply SPI_FSL_QUADSPI
       imply MTD_UBI
       imply BLK_DEV_LOOP
       imply BLK_DEV_RAM
       #imply BLK_DEV_RAM_SIZE=65536
       imply VIRTIO_BLK
       imply AD525X_DPOT
       imply AD525X_DPOT_I2C
       imply ATMEL_TCLIB
       imply ICS932S401
       #imply ATMEL_SSC
       #imply QCOM_COINCELL
       imply APDS9802ALS
       imply ISL29003
       imply EEPROM_AT24
       imply BLK_DEV_SD
       imply BLK_DEV_SR
       imply SCSI_MULTI_LUN
       imply ATA
       imply SATA_AHCI
       imply SATA_AHCI_PLATFORM
       imply AHCI_BRCM
       imply AHCI_ST
       imply AHCI_IMX
       imply AHCI_SUNXI
       imply AHCI_TEGRA
       imply SATA_HIGHBANK
       imply SATA_MV
       imply SATA_RCAR
       imply NETDEVICES
       imply VIRTIO_NET
       imply HIX5HD2_GMAC
       imply SUN4I_EMAC
       imply MACB
       #imply BCMGENET
       imply BGMAC_BCMA
       #imply SYSTEMPORT
       imply NET_CALXEDA_XGMAC
       imply GIANFAR
       imply IGB
       imply MV643XX_ETH
       imply MVNETA
       #imply PXA168_ETH
       imply KS8851
       imply R8169
       imply SH_ETH
       imply SMSC911X
       imply STMMAC_ETH
       imply SYNOPSYS_DWC_ETH_QOS
       imply TI_CPSW
       imply XILINX_EMACLITE
       imply AT803X_PHY
       imply MARVELL_PHY
       imply SMSC_PHY
       imply BROADCOM_PHY
       imply ICPLUS_PHY
       imply REALTEK_PHY
       imply MICREL_PHY
       imply FIXED_PHY
       imply USB_PEGASUS
       #imply USB_RTL8152
       imply USB_USBNET
       imply USB_NET_SMSC75XX
       imply USB_NET_SMSC95XX
       #imply BRCMFMAC
       #imply RT2X00
       #imply RT2800USB
       #imply MWIFIEX
       #imply MWIFIEX_SDIO
       imply INPUT_JOYDEV
       imply INPUT_EVDEV
       #imply KEYBOARD_QT1070
       imply KEYBOARD_GPIO
       imply KEYBOARD_TEGRA
       imply KEYBOARD_SPEAR
       imply KEYBOARD_ST_KEYSCAN
       #imply KEYBOARD_CROS_EC
       #imply KEYBOARD_SAMSUNG
       imply MOUSE_PS2_ELANTECH
       #imply MOUSE_CYAPA
       imply MOUSE_ELAN_I2C
       imply INPUT_TOUCHSCREEN
       #imply TOUCHSCREEN_ATMEL_MXT
       #imply TOUCHSCREEN_MMS114
       #imply TOUCHSCREEN_ST1232
       imply TOUCHSCREEN_STMPE
       imply TOUCHSCREEN_SUN4I
       #imply TOUCHSCREEN_WM97XX
       imply INPUT_MISC
       #imply INPUT_MAX77693_HAPTIC
       #imply INPUT_MAX8997_HAPTIC
       imply INPUT_MPU3050
       #imply INPUT_AXP20X_PEK
       #imply INPUT_ADXL34X
       imply SERIO_AMBAKMI
       imply SERIAL_8250
       imply SERIAL_8250_CONSOLE
       imply SERIAL_8250_DW
       imply SERIAL_8250_EM
       imply SERIAL_8250_MT6577
       imply SERIAL_8250_UNIPHIER
       imply SERIAL_AMBA_PL011
       imply SERIAL_AMBA_PL011_CONSOLE
       imply SERIAL_ATMEL
       imply SERIAL_ATMEL_CONSOLE
       imply SERIAL_ATMEL_TTYAT
       imply SERIAL_BCM63XX
       imply SERIAL_BCM63XX_CONSOLE
       imply SERIAL_MESON
       imply SERIAL_MESON_CONSOLE
       imply SERIAL_SAMSUNG
       imply SERIAL_SAMSUNG_CONSOLE
       imply SERIAL_SIRFSOC
       imply SERIAL_SIRFSOC_CONSOLE
       imply SERIAL_TEGRA
       imply SERIAL_IMX
       imply SERIAL_IMX_CONSOLE
       imply SERIAL_SH_SCI
       #imply SERIAL_SH_SCI_NR_UARTS=20
       imply SERIAL_SH_SCI_CONSOLE
       imply SERIAL_MSM
       imply SERIAL_MSM_CONSOLE
       imply SERIAL_VT8500
       imply SERIAL_VT8500_CONSOLE
       imply SERIAL_OF_PLATFORM
       imply SERIAL_OMAP
       imply SERIAL_OMAP_CONSOLE
       imply SERIAL_XILINX_PS_UART
       imply SERIAL_XILINX_PS_UART_CONSOLE
       imply SERIAL_FSL_LPUART
       imply SERIAL_FSL_LPUART_CONSOLE
       imply SERIAL_CONEXANT_DIGICOLOR
       imply SERIAL_CONEXANT_DIGICOLOR_CONSOLE
       imply SERIAL_ST_ASC
       imply SERIAL_ST_ASC_CONSOLE
       imply HVC_DRIVER
       imply VIRTIO_CONSOLE
       imply I2C_CHARDEV
       imply I2C_DAVINCI
       imply I2C_MUX
       #imply I2C_ARB_GPIO_CHALLENGE
       imply I2C_MUX_PCA954x
       imply I2C_MUX_PINCTRL
       imply I2C_DEMUX_PINCTRL
       #imply I2C_AT91
       imply I2C_BCM2835
       imply I2C_CADENCE
       imply I2C_DESIGNWARE_PLATFORM
       #imply I2C_DIGICOLOR
       #imply I2C_EMEV2
       #imply I2C_GPIO
       imply I2C_EXYNOS5
       #imply I2C_IMX
       imply I2C_MV64XXX
       imply I2C_RIIC
       imply I2C_RK3X
       imply I2C_S3C2410
       imply I2C_SH_MOBILE
       imply I2C_SIRF
       imply I2C_ST
       imply I2C_SUN6I_P2WI
       imply I2C_TEGRA
       imply I2C_UNIPHIER
       imply I2C_UNIPHIER_F
       imply I2C_XILINX
       imply I2C_RCAR
       #imply I2C_CROS_EC_TUNNEL
       imply I2C_SLAVE_EEPROM
       imply SPI
       #imply SPI_ATMEL
       imply SPI_BCM2835
       imply SPI_BCM2835AUX
       imply SPI_CADENCE
       imply SPI_DAVINCI
       #imply SPI_GPIO
       #imply SPI_FSL_DSPI
       imply SPI_OMAP24XX
       imply SPI_ORION
       imply SPI_PL022
       #imply SPI_ROCKCHIP
       imply SPI_RSPI
       #imply SPI_S3C64XX
       #imply SPI_SH_MSIOF
       imply SPI_SH_HSPI
       imply SPI_SIRF
       imply SPI_SUN4I
       imply SPI_SUN6I
       imply SPI_TEGRA114
       imply SPI_TEGRA20_SFLASH
       imply SPI_TEGRA20_SLINK
       imply SPI_XILINX
       imply SPI_SPIDEV
       imply SPMI
       imply PINCTRL_AS3722
       imply PINCTRL_PALMAS
       imply PINCTRL_BCM2835
       imply PINCTRL_APQ8064
       imply PINCTRL_APQ8084
       imply PINCTRL_IPQ8064
       imply PINCTRL_MSM8660
       imply PINCTRL_MSM8960
       imply PINCTRL_MSM8X74
       imply PINCTRL_MSM8916
       imply PINCTRL_QCOM_SPMI_PMIC
       imply PINCTRL_QCOM_SSBI_PMIC
       imply GPIO_GENERIC_PLATFORM
       imply GPIO_DAVINCI
       imply GPIO_DWAPB
       imply GPIO_EM
       imply GPIO_RCAR
       imply GPIO_XILINX
       imply GPIO_ZYNQ
       imply GPIO_PCA953X
       imply GPIO_PCA953X_IRQ
       imply GPIO_PCF857X
       imply GPIO_TWL4030
       imply GPIO_PALMAS
       imply GPIO_SYSCON
       imply GPIO_TPS6586X
       imply GPIO_TPS65910
       imply BATTERY_ACT8945A
       imply BATTERY_SBS
       #imply BATTERY_MAX17040
       #imply BATTERY_MAX17042
       #imply CHARGER_MAX14577
       #imply CHARGER_MAX77693
       #imply CHARGER_MAX8997
       #imply CHARGER_MAX8998
       imply CHARGER_TPS65090
       #imply AXP20X_POWER
       imply POWER_RESET_AS3722
       imply POWER_RESET_GPIO
       imply POWER_RESET_GPIO_RESTART
       imply POWER_RESET_KEYSTONE
       imply POWER_RESET_RMOBILE
       imply POWER_RESET_ST
       imply POWER_AVS
       imply ROCKCHIP_IODOMAIN
       imply SENSORS_IIO_HWMON
       imply SENSORS_LM90
       imply SENSORS_LM95245
       #imply SENSORS_NTC_THERMISTOR
       #imply SENSORS_PWM_FAN
       #imply SENSORS_INA2XX
       imply CPU_THERMAL
       imply ROCKCHIP_THERMAL
       imply RCAR_THERMAL
       imply ARMADA_THERMAL
       #imply DAVINCI_WATCHDOG
       #imply EXYNOS_THERMAL
       imply ST_THERMAL_MEMMAP
       imply WATCHDOG
       #imply DA9063_WATCHDOG
       imply XILINX_WATCHDOG
       imply ARM_SP805_WATCHDOG
       imply AT91SAM9X_WATCHDOG
       imply SAMA5D4_WATCHDOG
       imply ORION_WATCHDOG
       imply ST_LPC_WATCHDOG
       imply SUNXI_WATCHDOG
       imply IMX2_WDT
       #imply TEGRA_WATCHDOG
       imply MESON_WATCHDOG
       imply DW_WATCHDOG
       imply DIGICOLOR_WATCHDOG
       imply BCM2835_WDT
       imply BCM47XX_WDT
       #imply BCM7038_WDT
       imply BCM_KONA_WDT
       imply MFD_ACT8945A
       imply MFD_AS3711
       imply MFD_AS3722
       imply MFD_ATMEL_FLEXCOM
       #imply MFD_ATMEL_HLCDC
       imply MFD_BCM590XX
       imply MFD_AXP20X
       #imply MFD_AXP20X_I2C
       #imply MFD_AXP20X_RSB
       #imply MFD_CROS_EC
       #imply MFD_CROS_EC_I2C
       #imply MFD_CROS_EC_SPI
       #imply MFD_DA9063
       imply MFD_MAX14577
       imply MFD_MAX77686
       #imply MFD_MAX77693
       imply MFD_MAX8907
       imply MFD_MAX8997
       imply MFD_MAX8998
       imply MFD_RK808
       imply MFD_PM8XXX
       imply MFD_QCOM_RPM
       imply MFD_SPMI_PMIC
       imply MFD_SEC_CORE
       imply MFD_STMPE
       imply MFD_PALMAS
       imply MFD_TPS65090
       imply MFD_TPS65217
       imply MFD_TPS65218
       imply MFD_TPS6586X
       imply MFD_TPS65910
       imply REGULATOR_ACT8945A
       imply REGULATOR_AB8500
       imply REGULATOR_ACT8865
       imply REGULATOR_ANATOP
       imply REGULATOR_AS3711
       imply REGULATOR_AS3722
       #imply REGULATOR_AXP20X
       imply REGULATOR_BCM590XX
       imply REGULATOR_DA9210
       imply REGULATOR_FAN53555
       imply REGULATOR_RK808
       imply REGULATOR_GPIO
       imply MFD_SYSCON
       imply POWER_RESET_SYSCON
       imply REGULATOR_LP872X
       #imply REGULATOR_MAX14577
       imply REGULATOR_MAX8907
       imply REGULATOR_MAX8973
       #imply REGULATOR_MAX8997
       #imply REGULATOR_MAX8998
       imply REGULATOR_MAX77686
       #imply REGULATOR_MAX77693
       #imply REGULATOR_MAX77802
       imply REGULATOR_PALMAS
       imply REGULATOR_PBIAS
       imply REGULATOR_PWM
       imply REGULATOR_QCOM_RPM
       imply REGULATOR_QCOM_SMD_RPM
       imply REGULATOR_S2MPS11
       imply REGULATOR_S5M8767
       imply REGULATOR_TI_ABB
       imply REGULATOR_TPS51632
       imply REGULATOR_TPS62360
       imply REGULATOR_TPS65090
       imply REGULATOR_TPS65217
       imply REGULATOR_TPS65218
       imply REGULATOR_TPS6586X
       imply REGULATOR_TPS65910
       imply REGULATOR_TWL4030
       imply REGULATOR_VEXPRESS
       #imply REGULATOR_WM8994
       #imply MEDIA_SUPPORT
       imply MEDIA_CAMERA_SUPPORT
       imply MEDIA_CONTROLLER
       imply VIDEO_V4L2_SUBDEV_API
       imply MEDIA_USB_SUPPORT
       imply USB_VIDEO_CLASS
       imply USB_GSPCA
       imply V4L_PLATFORM_DRIVERS
       #imply SOC_CAMERA
       #imply SOC_CAMERA_PLATFORM
       #imply VIDEO_RCAR_VIN
       #imply VIDEO_ATMEL_ISI
       #imply VIDEO_SAMSUNG_EXYNOS4_IS
       #imply VIDEO_S5P_FIMC
       #imply VIDEO_S5P_MIPI_CSIS
       #imply VIDEO_EXYNOS_FIMC_LITE
       #imply VIDEO_EXYNOS4_FIMC_IS
       imply V4L_MEM2MEM_DRIVERS
       #imply VIDEO_SAMSUNG_S5P_JPEG
       #imply VIDEO_SAMSUNG_S5P_MFC
       #imply VIDEO_SAMSUNG_EXYNOS_GSC
       #imply VIDEO_STI_BDISP
       #imply VIDEO_STI_HVA
       #imply VIDEO_RENESAS_JPU
       #imply VIDEO_RENESAS_VSP1
       imply V4L_TEST_DRIVERS
       #imply VIDEO_ADV7180
       #imply VIDEO_ML86V7667
       imply DRM
       #imply DRM_I2C_ADV7511
       #imply DRM_DUMB_VGA_DAC
       #imply DRM_NXP_PTN3460
       #imply DRM_PARADE_PS8622
       #imply DRM_NOUVEAU
       #imply DRM_EXYNOS
       imply DRM_EXYNOS_FIMD
       imply DRM_EXYNOS_MIXER
       imply DRM_EXYNOS_DPI
       imply DRM_EXYNOS_DSI
       imply DRM_EXYNOS_HDMI
       #imply DRM_ROCKCHIP
       #imply ROCKCHIP_ANALOGIX_DP
       #imply ROCKCHIP_DW_HDMI
       #imply ROCKCHIP_DW_MIPI_DSI
       #imply ROCKCHIP_INNO_HDMI
       #imply DRM_ATMEL_HLCDC
       #imply DRM_RCAR_DU
       imply DRM_RCAR_HDMI
       imply DRM_RCAR_LVDS
       #imply DRM_SUN4I
       imply DRM_TEGRA
       #imply DRM_PANEL_SAMSUNG_LD9040
       #imply DRM_PANEL_SAMSUNG_S6E8AA0
       imply DRM_PANEL_SIMPLE
       #imply DRM_STI
       imply DRM_VC4
       imply FB_ARMCLCD
       imply FB_EFI
       imply FB_WM8505
       imply FB_SH_MOBILE_LCDC
       imply FB_SIMPLE
       imply FB_SH_MOBILE_MERAM
       imply BACKLIGHT_LCD_SUPPORT
       imply BACKLIGHT_CLASS_DEVICE
       #imply LCD_PLATFORM
       imply BACKLIGHT_PWM
       imply BACKLIGHT_AS3711
       imply FRAMEBUFFER_CONSOLE
       imply FRAMEBUFFER_CONSOLE_ROTATION
       #imply SOUND
       #imply SND
       imply SND_DYNAMIC_MINORS
       #imply SND_HDA_TEGRA
       imply SND_HDA_INPUT_BEEP
       imply SND_HDA_PATCH_LOADER
       #imply SND_HDA_CODEC_REALTEK
       #imply SND_HDA_CODEC_HDMI
       #imply SND_USB_AUDIO
       #imply SND_SOC
       #imply SND_ATMEL_SOC
       #imply SND_ATMEL_SOC_WM8904
       #imply SND_ATMEL_SOC_PDMIC
       #imply SND_BCM2835_SOC_I2S
       #imply SND_SOC_FSL_SAI
       #imply SND_SOC_ROCKCHIP
       #imply SND_SOC_ROCKCHIP_SPDIF
       #imply SND_SOC_ROCKCHIP_MAX98090
       #imply SND_SOC_ROCKCHIP_RT5645
       #imply SND_SOC_SAMSUNG
       #imply SND_SOC_SAMSUNG_SMDK_WM8994
       #imply SND_SOC_SMDK_WM8994_PCM
       #imply SND_SOC_SNOW
       #imply SND_SOC_SH4_FSI
       #imply SND_SOC_RCAR
       #imply SND_SOC_RSRC_CARD
       #imply SND_SUN4I_CODEC
       #imply SND_SOC_TEGRA
       #imply SND_SOC_TEGRA_RT5640
       #imply SND_SOC_TEGRA_WM8753
       #imply SND_SOC_TEGRA_WM8903
       #imply SND_SOC_TEGRA_WM9712
       #imply SND_SOC_TEGRA_TRIMSLICE
       #imply SND_SOC_TEGRA_ALC5632
       #imply SND_SOC_TEGRA_MAX98090
       #imply SND_SOC_AK4642
       #imply SND_SOC_SGTL5000
       #imply SND_SOC_SPDIF
       #imply SND_SOC_WM8978
       #imply SND_SOC_STI
       #imply SND_SOC_STI_SAS
       #imply SND_SIMPLE_CARD
       imply USB
       imply USB_XHCI_HCD
       imply USB_XHCI_MVEBU
       #imply USB_XHCI_RCAR
       #imply USB_XHCI_TEGRA
       imply USB_EHCI_HCD
       #imply USB_EHCI_MSM
       imply USB_EHCI_EXYNOS
       imply USB_EHCI_TEGRA
       imply USB_EHCI_HCD_STI
       imply USB_EHCI_HCD_PLATFORM
       imply USB_ISP1760
       imply USB_OHCI_HCD
       imply USB_OHCI_HCD_STI
       imply USB_OHCI_HCD_PLATFORM
       #imply USB_OHCI_EXYNOS
       #imply USB_R8A66597_HCD
       #imply USB_RENESAS_USBHS
       imply USB_STORAGE
       #imply USB_MUSB_HDRC
       #imply USB_MUSB_SUNXI
       imply USB_DWC3
       imply USB_DWC2
       imply USB_CHIPIDEA
       imply USB_CHIPIDEA_UDC
       imply USB_CHIPIDEA_HOST
       imply AB8500_USB
       imply KEYSTONE_USB_PHY
       imply OMAP_USB3
       imply USB_GPIO_VBUS
       imply USB_ISP1301
       #imply USB_MSM_OTG
       imply USB_MXS_PHY
       imply USB_GADGET
       imply USB_FSL_USB2
       #imply USB_RENESAS_USBHS_UDC
       #imply USB_ETH
       imply MMC
       #imply MMC_BLOCK_MINORS=16
       imply MMC_ARMMMCI
       imply MMC_SDHCI
       imply MMC_SDHCI_PLTFM
       imply MMC_SDHCI_OF_ARASAN
       imply MMC_SDHCI_OF_AT91
       #imply MMC_SDHCI_OF_ESDHC
       imply MMC_SDHCI_ESDHC_IMX
       imply MMC_SDHCI_DOVE
       imply MMC_SDHCI_TEGRA
       imply MMC_SDHCI_PXAV3
       imply MMC_SDHCI_SPEAR
       imply MMC_SDHCI_S3C
       imply MMC_SDHCI_S3C_DMA
       imply MMC_SDHCI_BCM_KONA
       imply MMC_SDHCI_ST
       imply MMC_OMAP
       imply MMC_OMAP_HS
       imply MMC_ATMELMCI
       imply MMC_SDHCI_MSM
       imply MMC_MVSDIO
       imply MMC_SDHI
       imply MMC_DW
       imply MMC_DW_IDMAC
       imply MMC_DW_PLTFM
       imply MMC_DW_EXYNOS
       imply MMC_DW_ROCKCHIP
       imply MMC_SH_MMCIF
       imply MMC_SUNXI
       imply NEW_LEDS
       imply LEDS_CLASS
       #imply LEDS_CLASS_FLASH
       imply LEDS_GPIO
       imply LEDS_PWM
       #imply LEDS_MAX77693
       #imply LEDS_MAX8997
       imply LEDS_TRIGGERS
       imply LEDS_TRIGGER_TIMER
       imply LEDS_TRIGGER_ONESHOT
       imply LEDS_TRIGGER_HEARTBEAT
       imply LEDS_TRIGGER_BACKLIGHT
       imply LEDS_TRIGGER_CPU
       imply LEDS_TRIGGER_GPIO
       imply LEDS_TRIGGER_DEFAULT_ON
       imply LEDS_TRIGGER_TRANSIENT
       imply LEDS_TRIGGER_CAMERA
       imply EDAC
       imply EDAC_MM_EDAC
       imply EDAC_HIGHBANK_MC
       imply EDAC_HIGHBANK_L2
       imply RTC_CLASS
       imply RTC_DRV_AS3722
       imply RTC_DRV_DS1307
       #imply RTC_DRV_HYM8563
       imply RTC_DRV_MAX8907
       #imply RTC_DRV_MAX8998
       #imply RTC_DRV_MAX8997
       imply RTC_DRV_MAX77686
       #imply RTC_DRV_RK808
       #imply RTC_DRV_RS5C372
       imply RTC_DRV_PALMAS
       imply RTC_DRV_ST_LPC
       imply RTC_DRV_TWL4030
       imply RTC_DRV_TPS6586X
       imply RTC_DRV_TPS65910
       #imply RTC_DRV_S35390A
       #imply RTC_DRV_RX8581
       imply RTC_DRV_EM3027
       #imply RTC_DRV_DA9063
       #imply RTC_DRV_EFI
       #imply RTC_DRV_DIGICOLOR
       #imply RTC_DRV_S5M
       #imply RTC_DRV_S3C
       imply RTC_DRV_PL031
       #imply RTC_DRV_AT91RM9200
       #imply RTC_DRV_AT91SAM9
       imply RTC_DRV_VT8500
       imply RTC_DRV_SUN6I
       imply RTC_DRV_SUNXI
       imply RTC_DRV_MV
       imply RTC_DRV_TEGRA
       imply DMADEVICES
       imply DW_DMAC
       imply AT_HDMAC
       imply AT_XDMAC
       imply FSL_EDMA
       imply MV_XOR
       imply TEGRA20_APB_DMA
       imply SH_DMAE
       imply RCAR_DMAC
       #imply RENESAS_USB_DMAC
       imply STE_DMA40
       imply SIRF_DMA
       imply TI_EDMA
       imply PL330_DMA
       imply IMX_SDMA
       imply IMX_DMA
       imply MXS_DMA
       imply DMA_BCM2835
       imply DMA_OMAP
       imply QCOM_BAM_DMA
       imply XILINX_DMA
       imply DMA_SUN6I
       #imply ST_FDMA
       imply STAGING
       imply SENSORS_ISL29018
       imply SENSORS_ISL29028
       imply MFD_NVEC
       imply KEYBOARD_NVEC
       imply SERIO_NVEC_PS2
       imply NVEC_POWER
       imply NVEC_PAZ00
       imply BCMA
       imply BCMA_HOST_SOC
       imply BCMA_DRIVER_GMAC_CMN
       imply BCMA_DRIVER_GPIO
       imply QCOM_GSBI
       imply QCOM_PM
       imply QCOM_SMEM
       imply QCOM_SMD
       imply QCOM_SMD_RPM
       imply QCOM_SMP2P
       imply QCOM_SMSM
       #imply QCOM_WCNSS_CTRL
       imply ROCKCHIP_PM_DOMAINS
       imply COMMON_CLK_QCOM
       imply QCOM_CLK_RPM
       imply CHROME_PLATFORMS
       imply STAGING_BOARD
       #imply CROS_EC_CHARDEV
       imply COMMON_CLK_MAX77686
       #imply COMMON_CLK_MAX77802
       #imply COMMON_CLK_RK808
       #imply COMMON_CLK_S2MPS11
       imply APQ_MMCC_8084
       imply MSM_GCC_8660
       imply MSM_MMCC_8960
       imply MSM_MMCC_8974
       imply HWSPINLOCK_QCOM
       imply ROCKCHIP_IOMMU
       imply TEGRA_IOMMU_GART
       imply TEGRA_IOMMU_SMMU
       #imply REMOTEPROC
       #imply ST_REMOTEPROC
       imply PM_DEVFREQ
       #imply ARM_TEGRA_DEVFREQ
       imply MEMORY
       imply EXTCON
       imply TI_AEMIF
       imply IIO
       #imply AT91_ADC
       #imply AT91_SAMA5D2_ADC
       #imply BERLIN2_ADC
       #imply EXYNOS_ADC
       #imply VF610_ADC
       imply XILINX_XADC
       #imply CM36651
       imply AK8975
       imply RASPBERRYPI_POWER
       imply PWM
       #imply PWM_ATMEL
       #imply PWM_ATMEL_HLCDC_PWM
       #imply PWM_ATMEL_TCB
       #imply PWM_FSL_FTM
       imply PWM_RENESAS_TPU
       #imply PWM_ROCKCHIP
       #imply PWM_SAMSUNG
       imply PWM_SUN4I
       imply PWM_TEGRA
       imply PWM_VT8500
       imply PHY_HIX5HD2_SATA
       imply E1000E
       imply PWM_STI
       imply PWM_BCM2835
       #imply PWM_BRCMSTB
       imply OMAP_USB2
       imply TI_PIPE3
       imply PHY_BERLIN_USB
       imply PHY_BERLIN_SATA
       #imply PHY_ROCKCHIP_DP
       #imply PHY_ROCKCHIP_USB
       #imply PHY_QCOM_APQ8064_SATA
       imply PHY_MIPHY28LP
       #imply PHY_RCAR_GEN2
       imply PHY_STIH407_USB
       imply PHY_SUN4I_USB
       imply PHY_SUN9I_USB
       #imply PHY_SAMSUNG_USB2
       imply PHY_TEGRA_XUSB
       imply PHY_BRCM_SATA
       imply NVMEM
       imply NVMEM_SUNXI_SID
       imply BCM2835_MBOX
       imply RASPBERRYPI_FIRMWARE
       #imply EFI_VARS
       #imply EFI_CAPSULE_LOADER
       imply BCM47XX_NVRAM
       imply BCM47XX_SPROM
       imply EXT4_FS
       imply AUTOFS4_FS
       imply MSDOS_FS
       imply VFAT_FS
       imply NTFS_FS
       imply TMPFS_POSIX_ACL
       imply UBIFS_FS
       imply TMPFS
       imply SQUASHFS
       imply SQUASHFS_LZO
       imply SQUASHFS_XZ
       imply NFS_FS
       imply NFS_V3_ACL
       imply NFS_V4
       imply ROOT_NFS
       imply NLS_CODEPAGE_437
       imply NLS_ISO8859_1
       imply NLS_UTF8
       imply PRINTK_TIME
       imply DEBUG_FS
       imply MAGIC_SYSRQ
       imply LOCKUP_DETECTOR
       imply CRYPTO_DEV_TEGRA_AES
       imply CPUFREQ_DT
       imply KEYSTONE_IRQ
       imply HW_RANDOM
       imply HW_RANDOM_ST
       #imply CRYPTO_DEV_MARVELL_CESA
       #imply CRYPTO_DEV_S5P
       #imply CRYPTO_DEV_SUN4I_SS
       #imply CRYPTO_DEV_ROCKCHIP
       imply ARM_CRYPTO
       #imply CRYPTO_SHA1_ARM
       #imply CRYPTO_SHA1_ARM_NEON
       #imply CRYPTO_SHA1_ARM_CE
       #imply CRYPTO_SHA2_ARM_CE
       #imply CRYPTO_SHA256_ARM
       #imply CRYPTO_SHA512_ARM
       #imply CRYPTO_AES_ARM
       #imply CRYPTO_AES_ARM_BS
       #imply CRYPTO_AES_ARM_CE
       #imply CRYPTO_GHASH_ARM_CE
       #imply CRYPTO_DEV_ATMEL_AES
       #imply CRYPTO_DEV_ATMEL_TDES
       #imply CRYPTO_DEV_ATMEL_SHA
       #imply VIDEO_VIVID
       imply VIRTIO
       imply VIRTIO_PCI
       imply VIRTIO_PCI_LEGACY
       imply VIRTIO_MMIO

source init/Kconfig

source net/Kconfig

source drivers/Kconfig

source fs/Kconfig

source mm/Kconfig

source kernel/Kconfig.preempt

source kernel/Kconfig.locks

source kernel/Kconfig.hz

source security/Kconfig

source crypto/Kconfig

source lib/Kconfig

source lib/Kconfig.debug
```
